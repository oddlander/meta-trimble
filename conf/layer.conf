## conf/layer.conf
```bitbake
# We have a conf and classes directory, add to BBPATH
BBPATH .= ":${LAYERDIR}"

# We have recipes-* directories, add to BBFILES
BBFILES += "${LAYERDIR}/recipes-*/*/*.bb \
	${LAYERDIR}/recipes-*/*/*.bbappend"

BBFILE_COLLECTIONS += "meta-trimble"
BBFILE_PATTERN_meta-trimble = "^${LAYERDIR}/"
BBFILE_PRIORITY_meta-trimble = "6"

# This should only be incremented on significant changes that will
# cause compatibility issues with other layers
LAYERVERSION_trimble = "1"

#initially no dependecies I can think of...
#LAYERDEPENDS_trimble = "core"
```

## conf/machine/imx51-imc.conf
```bitbake
#@TYPE: Machine
#@NAME: Trimble i.MX51 IMC
#@SOC: i.MX51
#@DESCRIPTION: Machine configuration for SX10 IMC Board
#@MAINTAINER: Robert Olander <robert.olander@trimble.se>

MACHINEOVERRIDES =. "mx5:mx51:"

include conf/machine/include/imx-base.inc
include conf/machine/include/tune-cortexa8.inc


# Disable perf features as 2.6.35.3 fails to build otherwise
PERF_FEATURES_ENABLE = ""

# will actually use IMX_DEFAULT_KERNEL (see imx-base.inc -> linux-fslc)
PREFERRED_PROVIDER_virtual/kernel ?= "linux-eleanor"
#PREFERRED_VERSION_linux-eleanor = "4.9%"

KERNEL_DEVICETREE = "imx51-imc.dtb"

#TODO: custom UBOOT_MACHINE config
#UBOOT_MACHINE = "imx51-imc_config"
UBOOT_MACHINE = "mx51evk_config"
```

## conf/machine/include/machine-trmb-default.inc
```bitbake
# Default Trimble BSP Machine settings

EXTRA_IMAGE_FEATURES = "debug-tweaks ssh-server-openssh tools-debug"
IMAGE_INSTALL_append = "openssh-sftp-server libstdc++ helloworld"
```

## conf/machine/zc702-guru.conf
```bitbake
#@TYPE: Machine
#@NAME: zc702-guru
#@DESCRIPTION: Machine support for Trimble ZC702 GURU Board.
#
# For the FSBL 'zynq_fsbl_0.elf' refer to UG873 and the associated design files.
#

require conf/machine/include/tune-zynq.inc
require conf/machine/include/machine-xilinx-default.inc

require conf/machine/include/machine-xilinx-board.inc

require conf/machine/include/machine-trmb-default.inc

MACHINE_FEATURES = "rtc ext2 ext3 vfat usbhost"

# fix for xilinx 'pyro' branch sill uses IMAGE_CLASSES += "image_types_uboot", not supported
IMAGE_CLASSES_remove = "image_types_uboot"

# u-boot configuration
UBOOT_MACHINE = "zynq_zc702_config"
SPL_BINARY = "spl/boot.bin"

EXTRA_IMAGEDEPENDS += "u-boot-zynq-uenv"

SERIAL_CONSOLE = "115200 ttyPS0"

KERNEL_DEVICETREE = "zynq-zc702.dtb"
KERNEL_FEATURES += "features/rtc/rtc.scc"

IMAGE_BOOT_FILES += "boot.bin uEnv.txt ${KERNEL_IMAGETYPE}-zynq-zc702.dtb"
```
